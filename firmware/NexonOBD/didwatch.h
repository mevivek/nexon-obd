#pragma once
#include <Arduino.h>

// Watching a handful of UDS identifiers alongside the live PIDs.
//
// A full 0000-FFFF sweep finds identifiers that answer; it cannot tell you what any
// of them hold. The manufacturer-specific block (ISO 14229-1 puts 0100-A5FF at the
// vehicle manufacturer's disposal) comes back as one or two raw bytes with no name,
// no unit and no scaling - that lives in an ODX database nobody outside Bosch has.
//
// What you can do is correlate. Read a few of them continuously while the engine
// state changes and record them on the same rows as rpm, coolant and speed; a value
// that rises with coolant during warm-up identifies itself. This holds the chosen
// set and the last reading of each. The polling lives in the sketch with everything
// else that touches the bus; everything here is pure, so it is testable on a host.
//
// This does not produce meaning, only correlation - it will tell you that 1002
// tracks coolant, not what its offset and scale are. Those come from fitting the
// logged column against the PID afterwards.

static const uint8_t WATCH_MAX = 8;

struct WatchDid {
  uint16_t did  = 0;
  uint8_t  ecu  = 0;          // 0 = ECM, 1 = TCM
  uint8_t  len  = 0;          // bytes in the last good reply; 0 = never answered
  uint8_t  data[8] = {0};
  uint32_t stamp = 0;         // millis() of that reply
};

static WatchDid watch[WATCH_MAX];
static uint8_t  watchN         = 0;
static uint32_t watchPeriodMs  = 1000;   // one identifier read per period, round robin
static uint8_t  watchTurn      = 0;
static uint32_t watchLastMs    = 0;
// Bumped whenever the set changes. The trip CSV gains a column pair per watched
// identifier, so a changed set has to rotate the file rather than shift columns
// under rows that are already written.
static uint32_t watchGen       = 0;

static const uint32_t WATCH_PERIOD_MIN =  250;
static const uint32_t WATCH_PERIOD_MAX = 10000;

// One pass over the whole set.
static uint32_t watchCycleMs() {
  return watchPeriodMs * (watchN ? watchN : 1);
}

// A reading is current if it has not missed its own turn. One cycle plus a period
// of slack, so a single dropped reply - which this adapter does regularly, see
// FINDINGS - does not flap the whole column between present and absent.
static bool watchFresh(const WatchDid &w, uint32_t now) {
  return w.len && w.stamp && (now - w.stamp) <= watchCycleMs() + watchPeriodMs;
}

// Big-endian unsigned, which is the UDS convention for a multi-byte value. Two
// bytes might equally be two packed u8s and nothing in the reply says which; this
// is right if it is a u16 and still correlates if it is not, which is why the raw
// bytes are logged beside it rather than instead of it.
static uint32_t watchValue(const WatchDid &w) {
  uint32_t v = 0;
  uint8_t n = w.len > 4 ? 4 : w.len;
  for (uint8_t i = 0; i < n; i++) v = (v << 8) | w.data[i];
  return v;
}

// E1002 / T0140 - responder and identifier, so the same DID on both ECUs stays
// distinguishable. The x suffix marks the raw column.
static void watchColName(char *out, size_t n, const WatchDid &w, bool hex) {
  snprintf(out, n, "%c%04X%s", w.ecu ? 'T' : 'E', (unsigned)w.did, hex ? "x" : "");
}

// The CSV header and the CSV row are generated by these two, walking the same set
// in the same order and returning the same count. That is the whole point of the
// pair: a column cannot appear in the header without a cell underneath it, which is
// the drift the fixed TRIP_COLS table already prevents for the static columns.
static const uint8_t WATCH_COLS_PER_DID = 2;

static uint8_t watchColNames(const WatchDid &w, char out[][12], uint8_t cap) {
  if (cap < WATCH_COLS_PER_DID) return 0;
  watchColName(out[0], 12, w, false);
  watchColName(out[1], 12, w, true);
  return WATCH_COLS_PER_DID;
}

static uint8_t watchColCells(const WatchDid &w, uint32_t now, char out[][20], uint8_t cap) {
  if (cap < WATCH_COLS_PER_DID) return 0;
  out[0][0] = 0;
  out[1][0] = 0;
  // Absent stays empty rather than zero, exactly as an absent PID does: a watched
  // identifier that stopped answering must not read as a value of nought.
  if (watchFresh(w, now)) {
    snprintf(out[0], 20, "%lu", (unsigned long)watchValue(w));
    size_t k = 0;
    for (uint8_t i = 0; i < w.len && k + 2 < 20; i++)
      k += snprintf(out[1] + k, 20 - k, "%02X", w.data[i]);
  }
  return WATCH_COLS_PER_DID;
}

// Stored as one blob rather than a key per field: NVS keys are capped at 15
// characters and eight identifiers would want thirty of them. Encoding is kept
// separate from the NVS call so the round trip can be exercised on a host.
static size_t watchEncode(const WatchDid *list, uint8_t n, uint8_t *out, size_t cap) {
  size_t k = 0;
  for (uint8_t i = 0; i < n && k + 3 <= cap; i++) {
    out[k++] = (uint8_t)(list[i].did >> 8);
    out[k++] = (uint8_t)(list[i].did & 0xFF);
    out[k++] = list[i].ecu ? 1 : 0;
  }
  return k;
}

static uint8_t watchDecode(const uint8_t *in, size_t len, WatchDid *out, uint8_t cap) {
  uint8_t n = 0;
  for (size_t k = 0; k + 3 <= len && n < cap; k += 3) {
    out[n] = WatchDid();                 // a restored entry has no reading yet
    out[n].did = (uint16_t)(((uint16_t)in[k] << 8) | in[k + 1]);
    out[n].ecu = in[k + 2] ? 1 : 0;
    n++;
  }
  return n;
}

// Replace the set, reporting whether anything actually changed.
//
// That answer matters more than it looks: a change rotates the trip CSV, and the
// page re-sends its selection whenever you press Apply. Treating an identical list
// as a change would start a fresh file every time, and a drive would end up as a
// pile of one-row CSVs.
static bool watchApply(const WatchDid *next, uint8_t n, uint32_t period) {
  if (period < WATCH_PERIOD_MIN) period = WATCH_PERIOD_MIN;
  if (period > WATCH_PERIOD_MAX) period = WATCH_PERIOD_MAX;
  if (n > WATCH_MAX) n = WATCH_MAX;

  bool changed = (n != watchN) || (period != watchPeriodMs);
  for (uint8_t i = 0; i < n && !changed; i++)
    if (next[i].did != watch[i].did || next[i].ecu != watch[i].ecu) changed = true;
  if (!changed) return false;

  // Readings are dropped rather than carried across. An entry that keeps its place
  // in the list is still a different column in a different file, and a value read
  // before the change does not belong under the new header.
  for (uint8_t i = 0; i < n; i++) watch[i] = next[i];
  watchN        = n;
  watchPeriodMs = period;
  watchTurn     = 0;
  watchLastMs   = 0;
  watchGen++;
  return true;
}

// Accepts "E1002", "T0140" or a bare "1002" (ECM assumed). Returns false for
// anything that is not four hex digits, so a typo drops that entry rather than
// silently watching identifier zero.
static bool watchParseOne(const char *s, WatchDid &out) {
  if (!s || !*s) return false;
  uint8_t ecu = 0;
  if (*s == 'T' || *s == 't') { ecu = 1; s++; }
  else if (*s == 'E' || *s == 'e') { s++; }
  if (strlen(s) != 4) return false;
  uint32_t v = 0;
  for (int i = 0; i < 4; i++) {
    char c = s[i];
    int d = (c >= '0' && c <= '9') ? c - '0'
          : (c >= 'A' && c <= 'F') ? c - 'A' + 10
          : (c >= 'a' && c <= 'f') ? c - 'a' + 10 : -1;
    if (d < 0) return false;
    v = (v << 4) | (uint32_t)d;
  }
  out = WatchDid();
  out.did = (uint16_t)v;
  out.ecu = ecu;
  return true;
}

// A comma-separated list into the watch set. Duplicates are dropped rather than
// wasting a turn of the round robin on a value that is already being read.
static uint8_t watchParseList(const char *csv, WatchDid *out, uint8_t cap) {
  uint8_t n = 0;
  char tok[16];
  size_t t = 0;
  for (const char *p = csv;; p++) {
    if (*p && *p != ',' && *p != ' ') {
      if (t + 1 < sizeof(tok)) tok[t++] = *p;
    } else {
      tok[t] = 0;
      WatchDid w;
      if (t && n < cap && watchParseOne(tok, w)) {
        bool dup = false;
        for (uint8_t i = 0; i < n; i++)
          if (out[i].did == w.did && out[i].ecu == w.ecu) dup = true;
        if (!dup) out[n++] = w;
      }
      t = 0;
      if (!*p) break;
    }
  }
  return n;
}
